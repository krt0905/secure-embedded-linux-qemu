/dts-v1/;
/plugin/;

/ {
    fragment@0 {
        target-path = "/";
        __overlay__ {
            signature {
                key-fit {
				required = "conf";
				algo = "sha256,rsa2048";
				rsa,r-squared = <0x785ae852 0xa9650e03 0x38df9f8b 0x70d80206 0xc10fcf4f 0x28a813ae 0xe615f2fd 0xee8f6ab4 0x9d83eeea 0x15700a82 0xfad5d4f8 0x3448bbb3 0xdf4d594a 0xf6e5e8ec 0x53c38cb1 0xbe49c621 0x14b2e294 0x2ce166fa 0x6a1c7c5a 0x45fce7a0 0xf0cf780e 0x46f3e768 0xd268a3cc 0xc81c5933 0x79cc825e 0x50d107cc 0xe94e9498 0xf30a86a1 0x3ebb8b35 0xb7088fb5 0xf3eae58e 0xee03dfdc 0x3168acd4 0xdf1c5578 0x63254731 0x49ec5146 0xcb044ff2 0x66998163 0x55156388 0xd9d45b75 0x3edfcf58 0x9c1f88c4 0x21795f3c 0x47a26dc 0xf14aa0be 0xf5b04258 0x22347693 0x1c8bc4c7 0xe2ba516a 0x196207ef 0xb1018fc4 0xeacb4244 0x704e6c8b 0x854dfc20 0x9acff4b5 0x188be88 0xf73d23d 0x27f8ab92 0x9114ac27 0x1e8024ad 0x4e69b98a 0xbb895d76 0x162646c8 0xa0d1fc9>;
				rsa,modulus = <0x93c44a9c 0xfab07831 0x6672f5c9 0xae8d37f1 0xdcfbb453 0x597c22eb 0x45722606 0x452d17b2 0x9cd51000 0x4c3559b9 0x261d39f 0x8f8ac802 0x6592d42e 0x4807ae2 0x8d8d334d 0x3b840a44 0x6aca7e95 0x25c6b475 0x8373ad76 0x475e0801 0xad19d4c0 0x4fe2b2dc 0x93f27f03 0x73645089 0xeb38eaea 0x94bec836 0x5a500347 0xf31465e4 0x3472c145 0x2983a019 0x6cf35f01 0x4a880b8a 0xe3f0e31e 0xabbac7ed 0x5775385a 0xc0fe12fd 0x69de4e3a 0xf50c5fe2 0x7ebdd46d 0x33774f5a 0x908b6abb 0x2450245b 0x93ed1597 0xef342477 0x3032caae 0xb4b6196d 0x68e218af 0xeae5d5a9 0x64bcad65 0x11dad420 0xbdc4bd79 0x53694730 0x5ed4673 0xa5302c68 0x28f983f1 0xe73b68b1 0x3d0eeb1d 0xa802d9e3 0x8c539e9 0x4fc3958b 0x8eb5fab2 0x45714d0f 0x59d03789 0x77b4cabb>;
				rsa,exponent = <0x00 0x10001>;
				rsa,n0-inverse = <0xdd31158d>;
				rsa,num-bits = <0x800>;
				key-name-hint = "fit";
                };
            };
        };
    };
};
